## firmware/sdkconfig.defaults
```kconfig
CONFIG_SCX_DEVICE_NAME="SanskarConnectX-DevKit"
CONFIG_SCX_WIFI_PROVISIONING_TIMEOUT_SECONDS=180
CONFIG_SCX_BLE_PAIRING_TIMEOUT_SECONDS=120
CONFIG_SCX_TELEMETRY_INTERVAL_SECONDS=30
CONFIG_SCX_ENABLE_SECURE_BOOT_CONCEPT=y
CONFIG_SCX_ENABLE_MANUFACTURING_MODE=y
```
